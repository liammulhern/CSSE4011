## CMakeLists.txt
```
# SPDX-License-Identifier: Apache-2.0
cmake_minimum_required(VERSION 3.20.0)
find_package(Zephyr REQUIRED HINTS $ENV{ZEPHYR_BASE})

project(gateway-uart)

add_subdirectory(
  ${CMAKE_CURRENT_SOURCE_DIR}/../common
  ${CMAKE_CURRENT_BINARY_DIR}/common
)

add_subdirectory(src)
```

## prj.conf
```kconfig
CONFIG_BT=y
CONFIG_BT_CENTRAL=y            # Central role support
CONFIG_BT_PERIPHERAL=n         # Disable peripheral role if not needed

CONFIG_BT_GATT_CLIENT=y        # Enable GATT client APIs (discovery, read)

CONFIG_BT_MAX_CONN=4
CONFIG_BT_MAX_PAIRED=4

# Enable logging (optional but recommended for printk output)
CONFIG_LOG=y
CONFIG_LOG_DEFAULT_LEVEL=3
CONFIG_LOG_MODE_DEFERRED=n
CONFIG_LOG_BUFFER_SIZE=4096
CONFIG_LOG_BACKEND_UART=y
CONFIG_PRINTK=y

# Kernel essentials (default usually sufficient)
CONFIG_MAIN_STACK_SIZE=4096
CONFIG_SYSTEM_WORKQUEUE_STACK_SIZE=4096


CONFIG_BT_BUF_ACL_RX_SIZE=200
CONFIG_BT_BUF_ACL_TX_SIZE=200

CONFIG_BT_L2CAP_TX_MTU= 71

# # enable floating point suppport
CONFIG_CBPRINTF_FP_SUPPORT=y

CONFIG_UUID=y
CONFIG_UUID_V4=y

# Enable Zephyr shell
CONFIG_SHELL=y
# Stop logs being backended automatically through shell
CONFIG_SHELL_LOG_BACKEND=n

# ESP specific
CONFIG_BT_L2CAP_TX_BUF_COUNT=12
CONFIG_BT_CONN_TX_MAX=12

CONFIG_BT_SMP=y
```

## src/main.c
```c
#include <zephyr/kernel.h>
#include <zephyr/types.h>
#include <zephyr/sys/printk.h>
#include <zephyr/bluetooth/bluetooth.h>
#include <zephyr/bluetooth/conn.h>
#include <zephyr/bluetooth/gatt.h>
#include <zephyr/bluetooth/hci.h>
#include <zephyr/bluetooth/uuid.h>

#include <bluetooth.h>

K_THREAD_DEFINE(process_data_tid, BASE_PROCESS_STACK_SIZE, process_data_thread, NULL, NULL, NULL, BASE_PROCESS_PRIORITY, 0, 0);
K_THREAD_DEFINE(base_tid, BASE_CONTROL_STACK_SIZE, base_thread, NULL, NULL, NULL, BASE_CONTROL_PRIORITY, 0, 0);
```
