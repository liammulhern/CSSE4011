## CMakeLists.txt
```
# SPDX-License-Identifier: Apache-2.0

cmake_minimum_required(VERSION 3.20.0)
find_package(Zephyr REQUIRED HINTS $ENV{ZEPHYR_BASE})

project(viewer)

include_directories(include)

add_subdirectory(src)
```

## prj.conf
```kconfig
#–– Core / Stacks ––
CONFIG_INIT_STACKS=y
CONFIG_MAIN_STACK_SIZE=2048
CONFIG_JSON_LIBRARY=y
CONFIG_REGULATOR=y

#–– Display & LVGL ––
CONFIG_DISPLAY=y
CONFIG_LVGL=y
CONFIG_LV_Z_MEM_POOL_SIZE=12000
CONFIG_SYS_CLOCK_TICKS_PER_SEC=1000
CONFIG_LV_USE_FLEX=y

#–– Networking Core ––
CONFIG_NETWORKING=y
CONFIG_NET_MGMT=y
CONFIG_NET_MGMT_EVENT=y
CONFIG_NET_MGMT_EVENT_INFO=y
CONFIG_NET_CONFIG_AUTO_INIT=y
CONFIG_NET_CONFIG_SETTINGS=y
CONFIG_NET_CONFIG_INIT_TIMEOUT=1

#–– Wi-Fi ––
CONFIG_WIFI=y
CONFIG_WIFI_ESP32=y
CONFIG_NET_L2_WIFI_MGMT=y

#–– IP Protocols ––
CONFIG_NET_IPV4=y
CONFIG_NET_IPV6=y
CONFIG_NET_ARP=y

#–– DHCP ––
CONFIG_NET_DHCPV4=y            # DHCP client (not strictly needed for AP)
CONFIG_NET_DHCPV4_SERVER=y     # ESP32 will hand out addresses

#–– Sockets & POSIX API ––
CONFIG_NET_TCP=y
CONFIG_NET_SOCKETS=y
CONFIG_POSIX_API=y

#–– DNS Resolver ––
CONFIG_DNS_RESOLVER=y
CONFIG_DNS_RESOLVER_AI_MAX_ENTRIES=10

#–– HTTP ––
CONFIG_HTTP_CLIENT=y

#–– Network Buffers & Contexts ––
CONFIG_NET_TX_STACK_SIZE=1024
CONFIG_NET_RX_STACK_SIZE=2048
CONFIG_NET_PKT_RX_COUNT=16
CONFIG_NET_PKT_TX_COUNT=16
CONFIG_NET_BUF_RX_COUNT=16
CONFIG_NET_BUF_TX_COUNT=16
CONFIG_NET_BUF_DATA_SIZE=256
CONFIG_NET_MAX_CONTEXTS=10

#–– Shell & Monitoring ––
CONFIG_SHELL=y
CONFIG_NET_SHELL=n
CONFIG_NET_BUF_POOL_USAGE=y

#-- Settings --
# CONFIG_FLASH=y
# CONFIG_FLASH_MAP=y
# CONFIG_SETTINGS=y
# CONFIG_SETTINGS_RUNTIME=n
# CONFIG_NVS=y
# CONFIG_SETTINGS_NVS=y
# CONFIG_MPU_ALLOW_FLASH_WRITE=y

#–– Logging ––
CONFIG_LOG=y
```

## boards/native_sim_native_64.conf
```kconfig
CONFIG_LV_Z_MEM_POOL_SIZE=128000
```

## boards/m5stack_core2_appcpu.overlay
```dts
/ {
    alias {
        display = &mipi_dbi;
    };

    chosen {
        zephyr,console = &uart0;
    };
};

&wifi {
    status = "okay";
};
```

## boards/m5stack_core2_esp32_procpu.overlay
```dts
&wifi {
    status = "okay";
};

&touch {
    status = "okay";
    compatible = "espressif,esp32-touch";
};
```

## src/main.c
```c
/*
 * Copyright (c) 2018 Jan Van Winkel <jan.van_winkel@dxplore.eu>
 *
 * SPDX-License-Identifier: Apache-2.0
 */

#include <zephyr/kernel.h>

#include <gui.h>
#include <parser.h>
#include <wifi.h>
#include <haptics.h>

#include <zephyr/logging/log.h>

LOG_MODULE_REGISTER(main_module, LOG_LEVEL_INF);

/* Application entry point */
int main(void)
{
    gui_init();
}

K_THREAD_DEFINE(gui_tid, GUI_THREAD_STACK_SIZE, gui_thread, NULL, NULL, NULL, GUI_THREAD_PRIORITY, 0, 0);
K_THREAD_DEFINE(wifi_tid, 12000, wifi_thread, NULL, NULL, NULL, GUI_THREAD_PRIORITY, 0, 0);
K_THREAD_DEFINE(haptics_tid, 256, haptics_thread, NULL, NULL, NULL, 7, 0, 0);
```

## include/gui.h
```c
#ifndef GUI_H_
#define GUI_H_

#include <lvgl.h>
#include <stddef.h>

#define GUI_THREAD_STACK_SIZE 4096
#define GUI_THREAD_PRIORITY 5

#define CARD_MARGIN        8
#define CARD_PADDING       6
#define CARD_RADIUS        5
#define CARD_BORDER_WIDTH  1

#define MAX_SSID_LEN 32
#define MAX_EXTRA_LEN 16

/* Called from any thread to schedule a Wi-Fi status update */
void gui_notify_wifi_status(const char *icon, const char *ssid, const char *extra);

/* Called from any thread to schedule a full notifications-screen redraw */
void gui_notify_notifications_update(void);

int gui_init(void);

void gui_thread(void);

#endif /* GUI_H_ */
```

## include/haptics.h
```c
#ifndef HAPTICS_H_
#define HAPTICS_H_

#include <zephyr/kernel.h>

void haptic_motor_vibrate(uint32_t count, uint32_t ms);

void haptics_thread(void);

#endif /* HAPTICS_H_ */
```

## include/http_get.h
```c
#include <stdio.h>
#include <stdlib.h>
#include <zephyr/net/socket.h>

void nslookup(const char * hostname, struct zsock_addrinfo **results);

void print_addrinfo_results(struct zsock_addrinfo **results);

void http_get(int sock, char * hostname, char * url);

int connect_socket(struct zsock_addrinfo **results, uint16_t port);
```

## include/parser.h
```c
#ifndef PARSER_H_
#define PARSER_H_

#include <zephyr/kernel.h>

#define MAX_NOTIFICATIONS 3
#define MAX_ID_LEN 10
#define MAX_TYPE_LEN 16
#define MAX_MESSAGE_LEN 128
#define MAX_TIMESTAMP_LEN 21   /* "YYYY-MM-DDTHH:MM:SSZ" + '\0' */

/* 1) In-memory notification struct */
typedef struct {
    char id[MAX_ID_LEN];
    char type[MAX_TYPE_LEN];
    char message[MAX_MESSAGE_LEN];
    char timestamp[MAX_TIMESTAMP_LEN];  /* raw ISO-8601 */
} notification_t;


extern notification_t notifications[MAX_NOTIFICATIONS];
extern size_t notification_count;

void parse_notifications(char *json_buf, size_t buf_len);

#endif // PARSER_H_
```

## include/ping.h
```c
void ping_server(char* ipv4_addr, uint8_t count);
```

## include/wifi.h
```c
#ifndef WIFI_H_
#define WIFI_H_

#define WIFI_RETRY_COUNT 10

#define MAX_SSID_LEN  32
#define MAX_PSK_LEN   64

extern char wifi_ssid[MAX_SSID_LEN];
extern char wifi_psk [MAX_PSK_LEN];

void wifi_connection_retry_reset(void);

void wifi_connect(void);

void wifi_callbacks_init(void);

void wifi_thread(void);

#endif // WIFI_H_
```

## src/cli.c
```c
#include <zephyr/shell/shell.h>
#include <zephyr/settings/settings.h>
#include <string.h>
#include <errno.h>
#include <wifi.h>   /* declare extern wifi_ssid[], wifi_psk[] and wifi_connect() */

/* set SSID */
static int cmd_wifi_set_ssid(const struct shell *sh, size_t argc, char **argv)
{
    size_t len = strlen(argv[1]);

    if (len >= MAX_SSID_LEN) {
        shell_error(sh, "SSID too long (max %d)", MAX_SSID_LEN - 1);
        return -EINVAL;
    }

    /* copy into our variable */
    strcpy(wifi_ssid, argv[1]);

    /* save to flash */
    settings_save_one("wifi/ssid", wifi_ssid, len);

    shell_print(sh, "Saved SSID: %s", wifi_ssid);
    return 0;
}

/* set PSK */
static int cmd_wifi_set_psk(const struct shell *sh, size_t argc, char **argv)
{
    size_t len = strlen(argv[1]);

    if (len >= MAX_PSK_LEN) {
        shell_error(sh, "PSK too long (max %d)", MAX_PSK_LEN - 1);
        return -EINVAL;
    }

    strcpy(wifi_psk, argv[1]);
    settings_save_one("wifi/psk", wifi_psk, len);

    shell_print(sh, "Saved PSK");
    return 0;
}

/* show current credentials */
static int cmd_wifi_show(const struct shell *sh, size_t argc, char **argv)
{
    shell_print(sh, "Current SSID: %s", wifi_ssid);
    shell_print(sh, "Current PSK : %s", wifi_psk);
    return 0;
}

/* trigger a connect */
static int cmd_wifi_connect(const struct shell *sh, size_t argc, char **argv)
{
    shell_print(sh, "Connecting to %s …", wifi_ssid);
    wifi_connection_retry_reset();
    wifi_connect();
    return 0;
}

SHELL_STATIC_SUBCMD_SET_CREATE(wifi_cmds,
    SHELL_CMD_ARG(ssid, NULL, "Set Wi-Fi SSID", cmd_wifi_set_ssid, 2, 0),
    SHELL_CMD_ARG(psk, NULL, "Set Wi-Fi PSK",  cmd_wifi_set_psk,  2, 0),
    SHELL_CMD(show, NULL, "Show Wi-Fi config", cmd_wifi_show),
    SHELL_CMD(connect, NULL, "Connect to Wi-Fi", cmd_wifi_connect),
    SHELL_SUBCMD_SET_END
);

SHELL_CMD_REGISTER(wifi, &wifi_cmds, "Wi-Fi commands", NULL);
```

## src/gui.c
```c
#include "font/lv_symbol_def.h"
#include <string.h>
#include <zephyr/kernel.h>
#include <zephyr/logging/log.h>
#include <zephyr/device.h>
#include <zephyr/devicetree.h>
#include <zephyr/drivers/display.h>
#include <parser.h>
#include <stdatomic.h>
#include <gui.h>
#include <display/lv_display.h>

#include <lvgl.h>

LOG_MODULE_REGISTER(gui_module, LOG_LEVEL_INF);

static lv_obj_t *wifi_lbl;
static lv_obj_t *content_scrl;

static atomic_bool wifi_update_flag;

static struct {
    char icon[8];
    char ssid[MAX_SSID_LEN];
    char extra[MAX_EXTRA_LEN];
} wifi_snapshot;

static atomic_bool notif_update_flag;

void gui_notify_wifi_status(const char *icon, const char *ssid, const char *extra)
{
    strncpy(wifi_snapshot.icon, icon, sizeof(wifi_snapshot.icon)-1);
    wifi_snapshot.icon[sizeof(wifi_snapshot.icon)-1] = '\0';

    strncpy(wifi_snapshot.ssid, ssid, sizeof(wifi_snapshot.ssid)-1);
    wifi_snapshot.ssid[sizeof(wifi_snapshot.ssid)-1] = '\0';

    strncpy(wifi_snapshot.extra, extra, sizeof(wifi_snapshot.extra)-1);
    wifi_snapshot.extra[sizeof(wifi_snapshot.extra)-1] = '\0';

    atomic_store(&wifi_update_flag, true);
}

void gui_notify_notifications_update(void)
{
    atomic_store(&notif_update_flag, true);
}

static void create_notification_card(lv_obj_t *parent,
                                     const notification_t *n)
{
    /* 1) Create the “card” container */
    lv_obj_t *card = lv_obj_create(parent);
    /* clear default style if you want a clean slate */
    lv_obj_remove_style_all(card);
    lv_obj_set_size(card, lv_pct(100), LV_SIZE_CONTENT);

    /* 2) Apply style: radius, padding, border, bg, margin */
    lv_obj_set_style_radius(card, CARD_RADIUS, 0);
    lv_obj_set_style_pad_all(card, CARD_PADDING, 0);
    lv_obj_set_style_border_width(card, CARD_BORDER_WIDTH, 0);
    lv_obj_set_style_border_color(card, lv_color_hex(0xCCCCCC), 0);
    lv_obj_set_style_bg_color(card, lv_color_hex(0xFFFFFF), 0);
    lv_obj_set_style_margin_all(card, CARD_MARGIN, 0);

    /* 3) Set up a vertical flex layout */
    lv_obj_set_layout(card, LV_LAYOUT_FLEX);
    lv_obj_set_flex_flow(card, LV_FLEX_FLOW_COLUMN);
    lv_obj_set_flex_align(card,
                          LV_FLEX_ALIGN_START,  /* main-axis align */
                          LV_FLEX_ALIGN_START,  /* cross-axis align */
                          LV_FLEX_ALIGN_START); /* track align */

    /* 4) Add the “type” label */
    lv_obj_t *type_lbl = lv_label_create(card);

    if (strcmp(n->type, "info") == 0) {
        lv_label_set_text_fmt(type_lbl, "%s [%s]" , LV_SYMBOL_BELL, n->type);
    } else if (strcmp(n->type, "warning") == 0) {
        lv_label_set_text_fmt(type_lbl, "%s [%s]" , LV_SYMBOL_WARNING, n->type);
        lv_obj_set_style_text_color(type_lbl, lv_color_hex(0xFFC107), 0); // yellow
    } else if (strcmp(n->type, "alert") == 0) {
        lv_label_set_text_fmt(type_lbl, "%s [%s]" , LV_SYMBOL_WARNING, n->type);
        lv_obj_set_style_text_color(type_lbl, lv_color_hex(0xDC3545), 0); // red
    } else {
        lv_label_set_text_fmt(type_lbl, "[%s]" , n->type);
        lv_obj_set_style_text_color(type_lbl, lv_color_hex(0x6C757D), 0); // gray
    }

    /* 5) Add the “message” label (wrapping) */
    lv_obj_t *msg_lbl = lv_label_create(card);

    lv_label_set_long_mode(msg_lbl, LV_LABEL_LONG_WRAP);

    lv_obj_set_width(msg_lbl, lv_pct(100));

    lv_label_set_text(msg_lbl, n->message);

    /* 6) Add the “timestamp” */
    lv_obj_t *ts_lbl = lv_label_create(card);
    lv_label_set_text(ts_lbl, n->timestamp);
}

void gui_show_notifications_screen()
{
    /* 1) Delete old content container if it exists */
    if (content_scrl) {
        lv_obj_del(content_scrl);
    }

    /* 1) Get the base screen and clear it */
    lv_obj_t *scr = lv_scr_act();

    /* 2) Create a plain container to hold everything */
    content_scrl = lv_obj_create(scr);

    /* 3) Make it full-screen */
    lv_obj_set_size(content_scrl, LV_PCT(100), LV_PCT(100));
    lv_obj_set_y(content_scrl, 32);

    /* 4) Enable vertical scrolling + auto-hiding scrollbar */
    lv_obj_set_scroll_dir(content_scrl, LV_DIR_VER);
    lv_obj_set_scrollbar_mode(content_scrl, LV_SCROLLBAR_MODE_AUTO);

    /* 5) Optional: remove its default padding/background if you want “bare” */
    lv_obj_set_style_bg_opa(content_scrl, LV_OPA_TRANSP, 0);
    lv_obj_set_style_pad_all(content_scrl, 0, 0);

    /* 6) Turn on flex layout so cards stack top→down */
    lv_obj_set_layout(content_scrl, LV_LAYOUT_FLEX);
    lv_obj_set_flex_flow(content_scrl, LV_FLEX_FLOW_COLUMN);
    lv_obj_set_flex_align(content_scrl,
                          LV_FLEX_ALIGN_START, /* main axis */
                          LV_FLEX_ALIGN_START, /* cross axis */
                          LV_FLEX_ALIGN_START);/* track align */

    /* 7) Add one “card” per notification */
    for (size_t i = 0; i < notification_count; i++) {
        create_notification_card(content_scrl, &notifications[i]);
    }
}


int gui_init() {
    const struct device *display_dev;

    display_dev = DEVICE_DT_GET(DT_CHOSEN(zephyr_display));

    if (!device_is_ready(display_dev)) {
        LOG_ERR("Device not ready, aborting test");
        return -ENODEV;
    }

    lv_timer_handler();
    display_blanking_off(display_dev);

    /* create a network‐status label at the very top */
    lv_obj_t *scr = lv_scr_act();
    wifi_lbl = lv_label_create(scr);
    lv_obj_set_width(wifi_lbl, LV_PCT(100));
    lv_obj_set_style_text_align(wifi_lbl, LV_TEXT_ALIGN_CENTER, 0);
    lv_obj_align(wifi_lbl, LV_ALIGN_TOP_MID, 0, 8);

    content_scrl = NULL;

    atomic_store(&wifi_update_flag, false);
    atomic_store(&notif_update_flag, false);

    gui_notify_wifi_status(LV_SYMBOL_WIFI, "N/A", "");


    /* Initialize the notifications array */
    notifications[0] = (notification_t) {
        .id = "1",
        .type = "info",
        .message = "No Notifications.",
        .timestamp = ""
    };

    notification_count = 1;

    return 0;
}

void gui_thread(void) {
    LOG_INF("GUI Thread started");

    gui_show_notifications_screen();

    while (1) {
        uint32_t sleep_ms = lv_timer_handler();

        /* Wi-Fi update if requested */
        if (atomic_exchange(&wifi_update_flag, false)) {
            lv_label_set_text_fmt(wifi_lbl, "%s Network: %s %s",
                                  wifi_snapshot.icon,
                                  wifi_snapshot.ssid,
                                  wifi_snapshot.extra);
        }

        /* Notifications update if requested */
        if (atomic_exchange(&notif_update_flag, false)) {
            gui_show_notifications_screen();
        }

        k_msleep(MIN(sleep_ms, INT32_MAX));
    }
}
```

## src/haptics.c
```c
// src/vibrator.c

#include <zephyr/kernel.h>
#include <zephyr/device.h>
#include <zephyr/devicetree.h>
#include <zephyr/drivers/regulator.h>
#include <zephyr/logging/log.h>

LOG_MODULE_REGISTER(vibrator, LOG_LEVEL_INF);

/* 1) Grab the vib_motor regulator from Devicetree */
#define VIB_NODE DT_NODELABEL(vib_motor)
#define VIB_DEV DEVICE_DT_GET(VIB_NODE)

/* 2) Semaphore to signal the worker thread */
static K_SEM_DEFINE(vib_sem, 0, 1);

/* 3) Parameters to pass to the thread */
static uint32_t vib_count;
static uint32_t vib_ms;

/**
 * Public API: ask the background thread to buzz 'count' times,
 * each pulse lasting 'ms' milliseconds (with 'ms' ms off between).
 */
void haptic_motor_vibrate(uint32_t count, uint32_t ms)
{
    vib_count = count;
    vib_ms = ms;

    /* wake up the worker */
    k_sem_give(&vib_sem);
}

/* Worker thread: waits for requests and runs the pattern */
void haptics_thread(void)
{
    if (!device_is_ready(VIB_DEV)) {
        LOG_ERR("Vibrator regulator not ready");
        return;
    }

    while (1) {
        /* wait until someone calls motor_vibrate_times() */
        k_sem_take(&vib_sem, K_FOREVER);

        for (uint32_t i = 0; i < vib_count; i++) {
            /* turn on */
            if (regulator_enable(VIB_DEV) < 0) {
                LOG_ERR("Failed to enable vibrator");
                break;
            }

            k_msleep(vib_ms);

            /* turn off */
            if (regulator_disable(VIB_DEV) < 0) {
                LOG_ERR("Failed to disable vibrator");
                break;
            }

            /* gap between pulses */
            k_msleep(vib_ms);
        }
    }
}

/* 4) Spawn the worker at boot */
```

## src/http_get.c
```c
#include <zephyr/net/socket.h>
#include <zephyr/kernel.h>
#include <zephyr/net/http/client.h>
#include <zephyr/logging/log.h>
#include <zephyr/net/http/client.h>
#include <zephyr/net/http/parser.h>
#include <env.h>
#include <parser.h>
#include <gui.h>

#define REQUEST_SIZE 1024
#define BODY_BUF_SIZE 1024

static uint8_t recv_buf[512];

LOG_MODULE_REGISTER(http_module, LOG_LEVEL_DBG);

static const char *http_headers[] = {
    "Authorization: Api-Key " API_KEY "\r\n",
    "Content-Type: application/json\r\n",
    "Content-Length: 0\r\n",
    NULL
};

/*  Parser state + settings */
static struct http_parser parser;
static struct http_parser_settings parser_settings;

/* Body accumulator */
static char body_buf[BODY_BUF_SIZE];
static size_t body_buf_len;

/* Called at the start of each message */
static int on_message_begin(struct http_parser *p) {
    ARG_UNUSED(p);
    body_buf_len = 0;
    return 0;
}

/* We don’t need URL, status or headers here, so leave them NULL */
/* Accumulate each body chunk into body_buf[] */
static int on_body(struct http_parser *p, const char *at, size_t length) {
    ARG_UNUSED(p);

    if (body_buf_len + length < BODY_BUF_SIZE - 1) {
        memcpy(body_buf + body_buf_len, at, length);
        body_buf_len += length;
    } else {
        LOG_ERR("Body too large (%zu + %zu > %zu)",
                body_buf_len, length, sizeof(body_buf));
        return -1;
    }

    return 0;
}

/* When the full message is done, NUL‐terminate and hand off */
static int on_message_complete(struct http_parser *p) {
    ARG_UNUSED(p);
    body_buf[body_buf_len] = '\0';
    LOG_INF("Full JSON payload (%zu bytes)", body_buf_len);

    /* parse and redraw GUI */
    parse_notifications(body_buf, body_buf_len);
    gui_notify_notifications_update();

    return 0;
}

static int parser_init_once(void)
{
    http_parser_init(&parser, HTTP_RESPONSE);
    http_parser_settings_init(&parser_settings);

    parser_settings.on_message_begin = on_message_begin;
    parser_settings.on_body = on_body;
    parser_settings.on_message_complete = on_message_complete;

    return 0;
}

/* Call this at startup, once */
SYS_INIT(parser_init_once, APPLICATION, CONFIG_APPLICATION_INIT_PRIORITY);

int nslookup(const char * hostname, struct zsock_addrinfo **results)
{
    struct zsock_addrinfo hints = {
        .ai_family   = AF_INET,       // try IPv4 first
        .ai_socktype = SOCK_STREAM,
    };

    int ret = zsock_getaddrinfo(hostname, NULL, &hints, results);

    if (ret < 0) {
        LOG_ERR("IPv4 failed (%d), falling back to IPv6", ret);

        hints.ai_family = AF_INET6;
        ret = zsock_getaddrinfo(hostname, NULL, &hints, results);

        if (ret < 0) {
            LOG_ERR("IPv6 lookup failed (%d)", ret);
            return -1;
        }
    }

    /* now res points to a list of valid addrs in the one family that worked */
    return 0;
}

void print_addrinfo_results(struct zsock_addrinfo **results)
{
    char ipv4[INET_ADDRSTRLEN];
    char ipv6[INET6_ADDRSTRLEN];
    struct sockaddr_in *sa;
    struct sockaddr_in6 *sa6;
    struct zsock_addrinfo *rp;
    
    for (rp = *results; rp != NULL; rp = rp->ai_next) {
        if (rp->ai_addr->sa_family == AF_INET) {
            // IPv4 Address
            sa = (struct sockaddr_in *) rp->ai_addr;
            zsock_inet_ntop(AF_INET, &sa->sin_addr, ipv4, INET_ADDRSTRLEN);
            LOG_INF("IPv4: %s\n", ipv4);
        }
        if (rp->ai_addr->sa_family == AF_INET6) {
            // IPv6 Address
            sa6 = (struct sockaddr_in6 *) rp->ai_addr;
            zsock_inet_ntop(AF_INET6, &sa6->sin6_addr, ipv6, INET6_ADDRSTRLEN);
            LOG_INF("IPv6: %s\n", ipv6);
        }
    }
}

int connect_socket(struct zsock_addrinfo **results, uint16_t port)
{
    struct zsock_addrinfo *rp;
    int sock, ret;

    for (rp = *results; rp; rp = rp->ai_next) {
        /* set the port in the sockaddr */
        if (rp->ai_family == AF_INET) {
            ((struct sockaddr_in *)rp->ai_addr)->sin_port = htons(port);
        } else if (rp->ai_family == AF_INET6) {
            ((struct sockaddr_in6 *)rp->ai_addr)->sin6_port = htons(port);
        }

        sock = zsock_socket(rp->ai_family,
                            rp->ai_socktype,
                            rp->ai_protocol);
        if (sock < 0) {
            LOG_ERR("socket() failed: %d\n", sock);
            continue;
        }

        ret = zsock_connect(sock,
                            rp->ai_addr,
                            rp->ai_addrlen);
        if (ret == 0) {
            LOG_INF("Connected on family %d\n", rp->ai_family);
            return sock;
        }

        if (ret < 0) {
            int err = errno;  /* POSIX errno */
            LOG_ERR("connect(family %d) → ret=%d, errno=%d (%s)\n",
                   rp->ai_family, ret, err, strerror(err));
            zsock_close(sock);
            continue;
        }
        zsock_close(sock);
    }

    return -1;
}


static int http_response_cb(struct http_response *rsp,
                            enum http_final_call final_data,
                            void *user_data)
{
    ARG_UNUSED(user_data);

     if (rsp->data_len > 0) {
        http_parser_execute(&parser,
                            &parser_settings,
                            (const char *)rsp->recv_buf,
                            rsp->data_len);
    }

    return 0;
}

int http_get(int sock, char * hostname, char * url)
{
    struct http_request req = { 0 };
    int ret;

    req.method = HTTP_GET;
    req.url = url;
    req.host = hostname;
    req.port = "3000";
    req.protocol = "HTTP/1.1";
    req.response = http_response_cb;
    req.recv_buf = recv_buf;
    req.recv_buf_len = sizeof(recv_buf);
    req.header_fields = http_headers;

    LOG_DBG("HTTP Request: %s %s%s %s\n", req.method == HTTP_GET ? "GET" : "POST", req.host, req.url, req.protocol);

    /* sock is a file descriptor referencing a socket that has been connected
    * to the HTTP server.
    */
    ret = http_client_req(sock, &req, 5000, NULL);

    return ret;
}

int http_query(char * hostname, char * url) {
    int sock;
    int ret;

    struct zsock_addrinfo *res;
    ret = nslookup(hostname, &res);

    if (ret < 0) {
        LOG_ERR("nslookup failed for %s: %d", hostname, ret);
        return ret;
    }

    print_addrinfo_results(&res);

    sock = connect_socket(&res, 3000);
    ret = http_get(sock, hostname, url);

    if (ret < 0) {
        LOG_ERR("HTTP GET failed: %d", ret);
    }

    zsock_freeaddrinfo(res);
    zsock_close(sock);

    return ret;
}
```

## src/parser.c
```c
#include <zephyr/kernel.h>
#include <zephyr/data/json.h>
#include <zephyr/logging/log.h>
#include <string.h>
#include <stdio.h>
#include <parser.h>
#include <haptics.h>

LOG_MODULE_REGISTER(parser_module, LOG_LEVEL_DBG);

/* Global array to hold parsed notifications */
notification_t notifications[MAX_NOTIFICATIONS];
size_t notification_count = 0;

static char prev_ids[MAX_NOTIFICATIONS][MAX_ID_LEN];
static size_t prev_count = 0;

/* 1) Descriptor for a single notification object */
static const struct json_obj_descr notif_descr[] = {
    JSON_OBJ_DESCR_PRIM_NAMED(notification_t, "id", id, JSON_TOK_STRING_BUF),
    JSON_OBJ_DESCR_PRIM_NAMED(notification_t, "type", type, JSON_TOK_STRING_BUF),
    JSON_OBJ_DESCR_PRIM_NAMED(notification_t, "message", message, JSON_TOK_STRING_BUF),
    JSON_OBJ_DESCR_PRIM_NAMED(notification_t, "timestamp", timestamp, JSON_TOK_STRING_BUF),
};

/* 2) Wrapper struct for the root‐level array */
struct notifications_root {
    notification_t notifications[MAX_NOTIFICATIONS];
    size_t notifications_len;
};

/* 3) Descriptor for the array of objects */
static const struct json_obj_descr arr_descr[] = {
    JSON_OBJ_DESCR_OBJ_ARRAY(struct notifications_root,
                             notifications,
                             MAX_NOTIFICATIONS,
                             notifications_len,
                             notif_descr, ARRAY_SIZE(notif_descr)),
};

/**
 * Parse a body_buf containing a JSON _array_ of notifications:
 *
 *   [
 *     {"id":"1", "type":"info", ...},
 *     {"id":"2", "type":"warning", ...}
 *   ]
 */void parse_notifications(char *json_buf, size_t buf_len)
{
    struct notifications_root wrap = {0};
    int rc;

    rc = json_arr_parse(json_buf, buf_len, arr_descr, &wrap); 

    if (rc < 0) {
        LOG_ERR("JSON parse failed: %d\n", rc);
        return;
    }

    /* Check if we have any new notifications */
    bool changed = false;

    if (wrap.notifications_len != prev_count) {
        changed = true;
    } else {
        for (size_t i = 0; i < wrap.notifications_len; i++) {
            if (strcmp(wrap.notifications[i].id, prev_ids[i]) != 0) {
                changed = true;
                break;
            }
        }
    }

    /* vibrate 2 pulses of 100ms to alert user */
    if (changed) {
        haptic_motor_vibrate(2, 100);
    }

    /* save off this batch of IDs for next time */
    prev_count = wrap.notifications_len;
    for (size_t i = 0; i < prev_count; i++) {
        strncpy(prev_ids[i], wrap.notifications[i].id, sizeof(prev_ids[i]) - 1);
        prev_ids[i][sizeof(prev_ids[i]) - 1] = '\0';
    }

    /* Copy out and parse timestamps */
    notification_count = wrap.notifications_len;

    for (size_t i = 0; i < notification_count; i++) {
        LOG_DBG("Notification %zu: id=%s, type=%s, message=%s, timestamp=%s",
               i, wrap.notifications[i].id,
               wrap.notifications[i].type,
               wrap.notifications[i].message,
               wrap.notifications[i].timestamp);

        /* copy raw fields */
        memcpy(&notifications[i], &wrap.notifications[i], sizeof(notification_t));
    }
}
```

## src/ping.c
```c
/* 
 * Copyright (c) 2024 Craig Peacock.
 * 
 * SPDX-License-Identifier: Apache-2.0
 */

#include <stdio.h>
#include <stdlib.h>
#include <zephyr/net/socket.h>
#include <zephyr/kernel.h>
#include <zephyr/net/icmp.h>
#include <zephyr/net/net_ip.h>

static int icmp_echo_reply_handler(struct net_icmp_ctx *ctx,
				struct net_pkt *pkt,
				struct net_icmp_ip_hdr *hdr,
				struct net_icmp_hdr *icmp_hdr,
				void *user_data)
{
	uint32_t cycles;
	char ipv4[INET_ADDRSTRLEN];
	zsock_inet_ntop(AF_INET, &hdr->ipv4->src, ipv4, INET_ADDRSTRLEN);

	uint32_t *start_cycles = user_data;

	cycles = k_cycle_get_32() - *start_cycles;

	printk("Reply from %s: bytes=%d time=%dms TTL=%d\r\n",
			ipv4,
			ntohs(hdr->ipv4->len),
			((uint32_t)k_cyc_to_ns_floor64(cycles) / 1000000),
			hdr->ipv4->ttl);
}

void ping_server(char* ipv4_addr, uint8_t count)
{
	uint32_t cycles;
	int ret;
	struct net_icmp_ctx icmp_context;

	// Register handler for echo reply
	ret = net_icmp_init_ctx(&icmp_context, NET_ICMPV4_ECHO_REPLY, 0, icmp_echo_reply_handler);
	if (ret != 0) {
		printk("Failed to init ping, err: %d", ret);
	}

	struct net_icmp_ping_params params;

	struct net_if *iface = net_if_get_default();
	struct sockaddr_in dst_addr;
	net_addr_pton(AF_INET, ipv4_addr, &dst_addr.sin_addr);
	dst_addr.sin_family = AF_INET;

	for (int i = 0; i < count; i++)
	{
		cycles = k_cycle_get_32();
		ret = net_icmp_send_echo_request(&icmp_context, iface, &dst_addr, NULL, &cycles);
		if (ret != 0) {
			printk("Failed to send ping, err: %d", ret);
		}
		k_sleep(K_SECONDS(2));
	}

	net_icmp_cleanup_ctx(&icmp_context);
}
```
