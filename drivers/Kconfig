## drivers/Kconfig
```kconfig
menu "Drivers"

rsource "gnss/Kconfig"
rsource "accelerometer/Kconfig"
rsource "evoc/Kconfig"
rsource "humidity/Kconfig"
rsource "temp/Kconfig"

endmenu
```

## drivers/gnss/ublox-neo-m9n/dts/bindings/gnss/ublox,neom9n.yaml
```yaml
# Copyright (c) 2022 Abel Sensors
# SPDX-License-Identifier: Apache-2.0

description: U-blox NEO-M9N GNSS Module

compatible: "u-blox,neom9n"

include: i2c-device.yaml
```

## drivers/gnss/ublox_neo_m9n/Kconfig
```kconfig
menuconfig UBLOX_NEO_M9N
    bool "Enable ublox_neo_m9n driver"
    default n
    depends on I2C
    help
      Enable the ublox_neo_m9n driver.  Requires CONFIG_I2C_IFACE=y.

if UBLOX_NEO_M9N

module = UBLOX_NEO_M9N
module-str = neom9n
source "subsys/logging/Kconfig.template.log_config"

config UBLOX_NEO_M9N_INIT_PRIORITY
    int "Counter init priority"
    default 80
    help
      NEO-M9N driver device initialization priority.

endif # UBLOX_NEO_M9N
```

## west.yml
```yaml
# Dependant on the west manifest file for upstream Zephyr.
# Zephyr revision should only point to an official release commit.
#
# Only imports subprojects currently required to minimise cloning time.

manifest:
  defaults:
    remote: upstream

  remotes:
    - name: upstream
      url-base: https://github.com/zephyrproject-rtos
    - name: liammulhern
      url-base: https://github.com/liammulhern

  projects:
    - name: zephyr
      repo-path: zephyr
      revision: main
      import: true
    - name: lvgl
      path: modules/lib/gui/lvgl
    - name: west-driver-init
      remote: liammulhern
      path: modules/west-driver-init
      revision: main
      west-commands: west_commands/west-commands.yml
```
